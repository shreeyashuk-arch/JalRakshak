## CMakeLists.txt
```
cmake_minimum_required(VERSION 3.20.0)

find_package(Zephyr REQUIRED HINTS $ENV{ZEPHYR_BASE})
project(jalrakshak_firmware)

target_include_directories(app PRIVATE include)

target_sources(app PRIVATE
    src/main.c
    src/sensors/sensor_manager.c
    src/ai/edge_ai_engine.c
    src/health/pump_health.c
    src/bluetooth/aquamesh.c
    src/telemetry/telemetry.c
)
```

## prj.conf
```kconfig
# JalRakshak nRF54LM20 DK Zephyr Project Configuration
# Target: nrf54lm20dk/nrf54lm20a/cpuapp or nrf54lm20dk/nrf54lm20b/cpuapp

# System & RTOS configuration
CONFIG_MAIN_STACK_SIZE=4096
CONFIG_SYSTEM_WORKQUEUE_STACK_SIZE=2048
CONFIG_HEAP_MEM_POOL_SIZE=8192
CONFIG_FPU=y

# Logging & Print formatting
CONFIG_LOG=y
CONFIG_LOG_DEFAULT_LEVEL=3
CONFIG_CBPRINTF_FP_SUPPORT=y

# Hardware Peripherals (I2C, SPI, ADC, GPIO, Flash)
CONFIG_GPIO=y
CONFIG_I2C=y
CONFIG_SPI=y
CONFIG_ADC=y
CONFIG_FLASH=y
CONFIG_FLASH_MAP=y
CONFIG_NVS=y

# Bluetooth LE & Bluetooth Mesh
CONFIG_BT=y
CONFIG_BT_SMP=y
CONFIG_BT_PERIPHERAL=y
CONFIG_BT_BROADCASTER=y
CONFIG_BT_OBSERVER=y
CONFIG_BT_MESH=y
CONFIG_BT_MESH_RELAY=y
CONFIG_BT_MESH_ADV_EXT=y
CONFIG_BT_DEVICE_NAME="JalRakshak-Node"

# TinyML / Edge AI acceleration support
CONFIG_CPLUSPLUS=y
CONFIG_LIB_CPLUSPLUS=y
CONFIG_NEWLIB_LIBC=y
CONFIG_NEWLIB_LIBC_FLOAT_PRINTF=y
```

## src/main.c
```c
#include <stdio.h>
#include <string.h>
#include "sensor_manager.h"
#include "edge_ai_engine.h"
#include "pump_health.h"
#include "aquamesh.h"
#include "telemetry.h"

#define WINDOW_SIZE 16

int main(void)
{
    printf("==================================================\n");
    printf("  JALRAKSHAK: Edge-AI Water Reliability System    \n");
    printf("  Target: Nordic Semiconductor nRF54LM20 DK       \n");
    printf("  Tagline: Predict the Failure. Protect the Water \n");
    printf("==================================================\n");

    /* Initialize subsystems */
    sensor_manager_init(true);
    edge_ai_engine_init();
    aquamesh_init();
    telemetry_init();

    printf("[System] Initialization complete. Sensor buffer online.\n");

    sensor_reading_t sample_window[WINDOW_SIZE];
    uint16_t sample_idx = 0;
    uint32_t iteration = 0;

    /* Main processing loop */
    while (iteration < 20) {
        sensor_reading_t current_sample;
        sensor_manager_read(&current_sample);
        sample_window[sample_idx++] = current_sample;

        if (sample_idx >= WINDOW_SIZE) {
            sample_idx = 0;
            ai_inference_result_t ai_result;
            edge_ai_process_window(sample_window, WINDOW_SIZE, &ai_result);

            water_impact_assessment_t assessment;
            pump_health_compute_impact(&ai_result, 0.85f, &assessment);

            aquamesh_telemetry_pkt_t pkt = {
                .protocol_version = 1,
                .node_id = 3,
                .node_type = NODE_TYPE_PUMP,
                .health_score = (uint8_t)assessment.pump_health_score,
                .reliability_score = (uint8_t)assessment.water_reliability_score,
                .risk_level = (assessment.priority >= MAINT_PRIORITY_HIGH_PRIORITY) ? 2 : 0,
                .maint_priority = (uint8_t)assessment.priority,
                .vib_rms_milli_g = (uint16_t)(ai_result.vibration_rms * 1000.0f),
                .current_rms_milli_a = (uint16_t)(ai_result.current_rms * 1000.0f),
                .temp_deci_c = (int16_t)(ai_result.temp_celsius * 10.0f),
                .flow_deci_lpm = (uint16_t)(ai_result.flow_efficiency * 850.0f),
                .seq_num = iteration
            };

            aquamesh_publish_telemetry(&pkt);
            telemetry_buffer_packet(&pkt);

            printf("[Edge-AI] Window %u: Health=%u%%, WaterReliability=%u/100, Priority=%d\n",
                   iteration, pkt.health_score, pkt.reliability_score, pkt.maint_priority);
        }
        iteration++;
    }

    printf("[System] Prototype loop demonstration finished successfully.\n");
    return 0;
}
```

## include/aquamesh.h
```c
#ifndef AQUAMESH_H_
#define AQUAMESH_H_

#include <stdint.h>
#include <stdbool.h>
#include "pump_health.h"

#ifdef __cplusplus
extern "C" {
#endif

#define AQUAMESH_MAX_NODE_ID_LEN 16

typedef enum {
    NODE_TYPE_PUMP = 1,
    NODE_TYPE_TANK = 2,
    NODE_TYPE_GATEWAY = 3
} aquamesh_node_type_t;

/* Packed Bluetooth Mesh Telemetry Payload (Fits in BLE Mesh Adv / Unsegmented PDU) */
typedef struct __attribute__((packed)) {
    uint8_t protocol_version;
    uint8_t node_id;
    uint8_t node_type;
    uint8_t health_score;       /* 0 - 100 */
    uint8_t reliability_score;  /* 0 - 100 */
    uint8_t risk_level;         /* 0: LOW, 1: MED, 2: HIGH, 3: CRIT */
    uint8_t maint_priority;     /* 0: NORMAL .. 4: CRITICAL */
    uint16_t vib_rms_milli_g;   /* milli-g */
    uint16_t current_rms_milli_a;
    int16_t temp_deci_c;        /* 0.1 deg C */
    uint16_t flow_deci_lpm;     /* 0.1 LPM */
    uint32_t seq_num;
} aquamesh_telemetry_pkt_t;

int aquamesh_init(void);
int aquamesh_publish_telemetry(const aquamesh_telemetry_pkt_t *pkt);
int aquamesh_sync_buffered_events(void);

#ifdef __cplusplus
}
#endif

#endif /* AQUAMESH_H_ */
```

## include/edge_ai_engine.h
```c
#ifndef EDGE_AI_ENGINE_H_
#define EDGE_AI_ENGINE_H_

#include "sensor_manager.h"
#include <stdint.h>

#ifdef __cplusplus
extern "C" {
#endif

typedef enum {
    HEALTH_STATE_HEALTHY = 0,
    HEALTH_STATE_DEGRADING = 1,
    HEALTH_STATE_CRITICAL = 2
} health_state_t;

typedef struct {
    float vibration_rms;
    float vibration_crest_factor;
    float current_rms;
    float temp_celsius;
    float flow_efficiency;  /* Normalized (1.0 = nominal) */
    
    health_state_t predicted_state;
    float anomaly_score;    /* 0.0 (normal) to 1.0 (abnormal) */
    float health_percentage;/* 100.0% down to 0.0% */
} ai_inference_result_t;

int edge_ai_engine_init(void);
int edge_ai_process_window(const sensor_reading_t *window, uint16_t sample_count, ai_inference_result_t *out_result);

#ifdef __cplusplus
}
#endif

#endif /* EDGE_AI_ENGINE_H_ */
```

## include/pump_health.h
```c
#ifndef PUMP_HEALTH_H_
#define PUMP_HEALTH_H_

#include "edge_ai_engine.h"
#include <stdint.h>

#ifdef __cplusplus
extern "C" {
#endif

typedef enum {
    MAINT_PRIORITY_NORMAL = 0,
    MAINT_PRIORITY_MONITOR = 1,
    MAINT_PRIORITY_INSPECT_SOON = 2,
    MAINT_PRIORITY_HIGH_PRIORITY = 3,
    MAINT_PRIORITY_CRITICAL = 4
} maintenance_priority_t;

typedef struct {
    float pump_health_score;        /* 0 - 100 */
    float flow_efficiency;          /* 0.0 - 1.0 */
    float tank_recovery_factor;     /* 0.0 - 1.0 */
    float water_reliability_score;  /* 0 - 100 prototype metric */
    maintenance_priority_t priority;
    char recommendation[128];
    uint32_t est_maint_window_hours_min;
    uint32_t est_maint_window_hours_max;
} water_impact_assessment_t;

void pump_health_compute_impact(const ai_inference_result_t *ai_res, float current_tank_recovery, water_impact_assessment_t *out_assessment);

#ifdef __cplusplus
}
#endif

#endif /* PUMP_HEALTH_H_ */
```

## include/sensor_manager.h
```c
#ifndef SENSOR_MANAGER_H_
#define SENSOR_MANAGER_H_

#include <stdint.h>
#include <stdbool.h>

#ifdef __cplusplus
extern "C" {
#endif

typedef struct {
    float vibration_x;      /* g */
    float vibration_y;      /* g */
    float vibration_z;      /* g */
    float motor_current;    /* Amperes (RMS) */
    float temperature;      /* Degrees Celsius */
    float flow_rate;        /* Liters per minute */
    float tank_level;       /* Percentage 0.0 - 100.0 */
    uint32_t timestamp_ms;
} sensor_reading_t;

int sensor_manager_init(bool use_simulated_mode);
int sensor_manager_read(sensor_reading_t *out_reading);
void sensor_manager_set_simulation_fault(int fault_type, float severity);

#ifdef __cplusplus
}
#endif

#endif /* SENSOR_MANAGER_H_ */
```

## include/telemetry.h
```c
#ifndef TELEMETRY_H_
#define TELEMETRY_H_

#include <stdint.h>
#include <stdbool.h>
#include "aquamesh.h"

#ifdef __cplusplus
extern "C" {
#endif

#define TELEMETRY_BUFFER_SIZE 64

int telemetry_init(void);
int telemetry_buffer_packet(const aquamesh_telemetry_pkt_t *pkt);
int telemetry_get_unflushed_count(void);
int telemetry_flush_to_gateway(void);

#ifdef __cplusplus
}
#endif

#endif /* TELEMETRY_H_ */
```
